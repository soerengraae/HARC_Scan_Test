## CMakeLists.txt
```
cmake_minimum_required(VERSION 3.20.0)
find_package(Zephyr REQUIRED HINTS $ENV{ZEPHYR_BASE})

project(VCPcontroller)

target_sources(app PRIVATE
    src/main.c
    src/ble_scanner.c
    src/uart_commands.c
)
```

## prj.conf
```kconfig
CONFIG_BT=y
CONFIG_BT_AUDIO=y
CONFIG_BT_VCP_VOL_CTLR=y
CONFIG_BT_GATT_AUTO_DISCOVER_CCC=y
CONFIG_BT_CENTRAL=y
CONFIG_BT_PERIPHERAL=y
CONFIG_BT_GATT_CLIENT=y
CONFIG_BT_SMP=y
CONFIG_BT_DEVICE_NAME="HARC Remote"

CONFIG_LOG=y
# Make buffer huge to capture all logs
CONFIG_LOG_BUFFER_SIZE=16384
CONFIG_MAIN_STACK_SIZE=2048
CONFIG_SYSTEM_WORKQUEUE_STACK_SIZE=2048

# Enable heap for k_malloc
CONFIG_HEAP_MEM_POOL_SIZE=2048
```

## src/main.c
```c
#include <zephyr/kernel.h>
#include <zephyr/bluetooth/bluetooth.h>
#include <zephyr/logging/log.h>

#include "ble_scanner.h"
#include "uart_commands.h"

LOG_MODULE_REGISTER(main, LOG_LEVEL_DBG);

static void bt_ready(int err)
{
	if (err) {
		LOG_ERR("Bluetooth init failed (err %d)", err);
		return;
	}

	LOG_INF("Bluetooth initialized");

	/* Initialize BLE scanner */
	err = ble_scanner_init();
	if (err) {
		LOG_ERR("BLE scanner init failed (err %d)", err);
		return;
	}

	ble_scanner_start();
}

int main(void)
{
	int err;

	/* Initialize UART commands */
	err = uart_commands_init();
	if (err) {
		LOG_ERR("UART commands init failed (err %d)", err);
		return err;
	}

	/* Initialize Bluetooth */
	err = bt_enable(bt_ready);
	if (err) {
		LOG_ERR("Bluetooth init failed (err %d)", err);
		return err;
	}

	/* Start UART command interface */
	uart_commands_start();

	return 0;
}
```

## src/ble_scanner.c
```c
#include "ble_scanner.h"
#include <zephyr/logging/log.h>
#include <zephyr/sys/byteorder.h>
#include <zephyr/bluetooth/uuid.h>
#include <zephyr/bluetooth/audio/vcp.h>
#include <string.h>

LOG_MODULE_REGISTER(ble_scanner, LOG_LEVEL_INF);

uint8_t deviceCount = 0;
uint8_t hiCount = 0;

struct k_work_delayable printDevicesWork;

static void printDevicesHandler(struct k_work *work)
{
	(void)(work);
	// printDiscoveredDevices();
	k_work_schedule(&printDevicesWork, K_SECONDS(10));
}

struct bt_device_node *clearDiscoveredDevices(void)
{
	struct bt_device_node *current = discovered_devices;
	struct bt_device_node *next;

	while (current)
	{
		next = current->next;
		k_free(current);
		current = next;
	}

	discovered_devices = NULL;
	hiCount = 0;

	return discovered_devices;
}

size_t getDevicesMemoryUsed(void)
{
	LOG_DBG("Devices: %d", deviceCount);
	LOG_DBG("Size of device node: %zu", sizeof(struct bt_device_node));
	return deviceCount * sizeof(struct bt_device_node);
}

struct bt_device_node *createDevice(void) {
	struct bt_device_node *new_node = k_malloc(sizeof(struct bt_device_node));
	if (!new_node)
	{
		LOG_ERR("Memory allocation failed");
		return NULL;
	}
	memset(new_node, 0, sizeof(*new_node)); // Initialize all fields to zero/NULL
	return new_node;
}

/* Save discovered device address */
bool saveHI(struct device_info *info)
{
	struct bt_device_node *current = discovered_devices;

	/* Check if the address is already in the list */
	while (current)
	{
		if (!bt_addr_le_cmp(&current->info.addr, &info->addr)) // Compare with the new info structure
		{
			return false; // Address already exists
		}
		current = current->next;
	}

	char addr_str[BT_ADDR_LE_STR_LEN];
	bt_addr_le_to_str(&info->addr, addr_str, sizeof(addr_str));
	LOG_INF("Saving device: %s", addr_str);

	/* Add new address to the list */
	if (getDevicesMemoryUsed() + sizeof(*current) > MAX_DISCOVERED_DEVICES_MEMORY_SIZE)
	{
		LOG_WRN("Memory limit reached (%zu bytes) - cannot save more addresses", getDevicesMemoryUsed());
		return false;
	}

	LOG_DBG("Allocating memory (%d bytes) for new device node", sizeof(struct bt_device_node));
	struct bt_device_node *new_node = createDevice();
	if (!new_node)
	{
		LOG_ERR("Memory allocation failed");
		return false;
	}

	bt_addr_le_copy(&new_node->info.addr, &info->addr);
	strncpy(new_node->info.name, info->name, BT_NAME_MAX_LEN); // Copy name with max length
	new_node->info.name[BT_NAME_MAX_LEN] = '\0'; // Ensure null-termination
	new_node->info.isHI = info->isHI;
	new_node->info.hasName = info->hasName;
	new_node->next = discovered_devices;
	discovered_devices = new_node;

	deviceCount++;

	if (new_node->info.isHI) {
		hiCount++;
		printDiscoveredHIs();
	}

	LOG_DBG("Saved new HI");

	return true;
}

struct bt_device_node *getHIByAddr(const bt_addr_le_t *addr)
{
	struct bt_device_node *current = discovered_devices;

	while (current)
	{
		if (!bt_addr_le_cmp(&current->info.addr, addr))
		{
			return current;
		}

		current = current->next;
	}

	return NULL;
}

struct bt_device_node *getHIByName(const char *name)
{
	struct bt_device_node *current = discovered_devices;

	while (current)
	{
		if (strcmp(current->info.name, name) == 0)
		{
			return current;
		}

		current = current->next;
	}

	return NULL;
}

void printDiscoveredHIs(void)
{
	if (!discovered_devices)
	{
		LOG_INF("No HIs discovered yet.");
		return;
	}

	LOG_INF("%d discovered HIs (only displaying the ones with names):", hiCount);
	struct bt_device_node *current = discovered_devices;
	if (!current)
	{
		return;
	}
	else
	{
		while (current)
		{
			if (current->info.isHI && current->info.hasName)
			{
				char addr_str[BT_ADDR_LE_STR_LEN];
				bt_addr_le_to_str(&current->info.addr, addr_str, sizeof(addr_str));
				LOG_INF(" - %s, %s", addr_str, current->info.name);
			}
			current = current->next;
		}
	}
}

/* Connection callbacks */
static void connected(struct bt_conn *conn, uint8_t err)
{
}

static void disconnected(struct bt_conn *conn, uint8_t reason)
{
}

BT_CONN_CB_DEFINE(conn_callbacks) = {
	.connected = connected,
	.disconnected = disconnected,
};

/* Device discovery function
   Extracts HAS service and device name from advertisement data */
static bool device_found(struct bt_data *data, void *user_data)
{
	struct device_info *info = (struct device_info *)user_data;
	char addr_str[BT_ADDR_LE_STR_LEN];
	bt_addr_le_to_str(&info->addr, addr_str, sizeof(addr_str));

	struct bt_device_node *existing_device = getHIByAddr(&info->addr);

	if (existing_device && existing_device->info.hasName)
		LOG_DBG("Advertisement data type 0x%X len %u from %s", data->type, data->data_len, existing_device->info.name);
	else
		LOG_DBG("Advertisement data type 0x%X len %u from %s", data->type, data->data_len, addr_str);

	switch (data->type)
	{
		case BT_DATA_SVC_DATA16:
			// Parse 16-bit service data
			if (data->data_len >= 2)
			{
				for (size_t i = 0; i <= data->data_len - 2; i += 2)
				{
					uint16_t uuid_val = sys_get_le16(&data->data[i]);
					LOG_DBG("Service Data UUID 0x%04X", uuid_val);

					if (uuid_val == 0xFEFE)
					{
						LOG_DBG("Found GN Hearing HI service UUID");
						info->isHI = true;

						if (existing_device != NULL)
							existing_device->info.isHI = info->isHI;
						else
							saveHI(info);

						break;
					}
				}
			}
			
			break;

		case BT_DATA_NAME_COMPLETE:
		case BT_DATA_NAME_SHORTENED:
			size_t name_len = MIN(data->data_len, BT_NAME_MAX_LEN);
			memcpy(info->name, data->data, name_len);
			info->name[name_len] = '\0';
			info->hasName = true;
			if (existing_device != NULL && !existing_device->info.hasName) {
				strcpy(existing_device->info.name, info->name);
				existing_device->info.hasName = true;
				if (existing_device->info.isHI)
					printDiscoveredHIs();
			}

			break;

		default:
			return true;
	}

	return true;
}

static void device_found_cb(const bt_addr_le_t *addr, int8_t rssi, uint8_t type, struct net_buf_simple *ad)
{
	char addr_str[BT_ADDR_LE_STR_LEN];
	struct device_info info = {0};

	/* Initialize device info structure */
	info.addr = *addr;
	info.isHI = false;
	info.hasName = false;
	memset(info.name, 0, sizeof(info.name));

	bt_addr_le_to_str(addr, addr_str, sizeof(addr_str));

	/* Parse advertisement data to extract HAS service and name */
	bt_data_parse(ad, device_found, &info);
}

/* Start BLE scanning */
void ble_scanner_start(void)
{
	int err;

	/* Stop any existing scan first */
	// bt_le_scan_stop();

	err = bt_le_scan_start(BT_LE_SCAN_ACTIVE, device_found_cb);
	if (err)
	{
		LOG_ERR("Scanning failed to start (err %d)", err);
		return;
	}

	LOG_INF("Scanning for HIs");

	k_work_init_delayable(&printDevicesWork, printDevicesHandler);
	k_work_schedule(&printDevicesWork, K_SECONDS(10));
}

/* Initialize BLE scanner */
int ble_scanner_init(void)
{
	LOG_INF("BLE scanner initialized");
	return 0;
}
```

## src/ble_scanner.h
```c
#ifndef BLE_SCANNER_H
#define BLE_SCANNER_H

#include <zephyr/kernel.h>
#include <zephyr/bluetooth/bluetooth.h>
#include <zephyr/bluetooth/conn.h>
#include <stdint.h>

#define MAX_DISCOVERED_DEVICES_MEMORY_SIZE 1024 // 1 KB
#define BT_NAME_MAX_LEN 12

extern uint8_t deviceCount;
extern uint8_t hiCount;

/* Structure to pass data between parsing callbacks */
struct device_info
{
	bt_addr_le_t addr;
	char name[BT_NAME_MAX_LEN + 1];
	bool isHI;
	bool hasName;
};

struct bt_device_node
{
	struct device_info info;
	struct bt_device_node *next;
} *discovered_devices = NULL;

/* BLE scanner functions */
int ble_scanner_init(void);
void ble_scanner_start(void);
void printDiscoveredDevices(void);
void printDiscoveredHIs(void);
struct bt_device_node *clearDiscoveredDevices(void);
struct bt_device_node *getHIByAddr(const bt_addr_le_t *addr);
struct bt_device_node *getHIByName(const char *name);
size_t getDevicesMemoryUsed(void);
struct bt_device_node *createDevice(void);
bool saveHI(struct device_info *info);

/* Connection management */
extern struct bt_conn_cb conn_callbacks;

#endif /* BLE_SCANNER_H */
```

## src/uart_commands.c
```c
#include "uart_commands.h"
#include "ble_scanner.h"
#include <zephyr/logging/log.h>
#include <zephyr/console/console.h>
#include <string.h>

LOG_MODULE_REGISTER(uart_commands, LOG_LEVEL_INF);

#define COMMAND_BUFFER_SIZE 64

static void process_command(const char *cmd)
{
    if (strlen(cmd) == 0) {
        return;
    }

    LOG_INF("Processing command: '%s'", cmd);

    switch (cmd[0]) {
        case '?':
            printDiscoveredHIs();
            break;

        default:
            LOG_INF("Unknown command: '%c'", cmd[0]);
            LOG_INF("Available commands:");
            LOG_INF("  ?: Print discovered HIs");
            break;
    }
}

static void uart_command_thread(void)
{
    char command_buffer[COMMAND_BUFFER_SIZE];

    LOG_INF("UART command interface ready");

    while (1) {
        char *line = console_getline();
        if (line != NULL) {
            // Remove trailing newline if present
            size_t len = strlen(line);
            if (len > 0 && line[len-1] == '\n') {
                line[len-1] = '\0';
            }

            if (strlen(line) > 0) {
                strncpy(command_buffer, line, COMMAND_BUFFER_SIZE - 1);
                command_buffer[COMMAND_BUFFER_SIZE - 1] = '\0';
                process_command(command_buffer);
            }
        }
        k_msleep(10);
    }
}

K_THREAD_DEFINE(uart_cmd_thread, 1024, uart_command_thread, NULL, NULL, NULL, 7, 0, 0);

int uart_commands_init(void)
{
    console_init();
    LOG_INF("UART commands initialized");
    return 0;
}

void uart_commands_start(void)
{
    LOG_INF("UART command interface started");
}
```

## src/uart_commands.h
```c
#ifndef UART_COMMANDS_H
#define UART_COMMANDS_H

#include <zephyr/kernel.h>

/* UART command functions */
int uart_commands_init(void);
void uart_commands_start(void);

#endif /* UART_COMMANDS_H */
```

## src/vcp_controller.c
```c
#include "vcp_controller.h"
#include <zephyr/logging/log.h>

LOG_MODULE_REGISTER(vcp_controller, LOG_LEVEL_DBG);

/* Global state variables */
struct bt_conn *default_conn;
struct bt_vcp_vol_ctlr *vol_ctlr;
bool vcp_discovered = false;

/* Note: bt_vcp_vol_ctlr_vol_up_unmute and bt_vcp_vol_ctlr_vol_down_unmute
 * are provided by Zephyr as atomic operations - no custom implementation needed */


/* VCP callback implementations */
static void vcp_discover_cb(struct bt_vcp_vol_ctlr *vcp_vol_ctlr, int err,
			    uint8_t vocs_count, uint8_t aics_count)
{
	if (err) {
		LOG_ERR("VCP discovery failed (err %d)", err);
		return;
	}

	LOG_INF("VCP discovery complete - VOCS: %u, AICS: %u", vocs_count, aics_count);
	vol_ctlr = vcp_vol_ctlr;
	vcp_discovered = true;
}

static void vcp_vol_down_cb(struct bt_vcp_vol_ctlr *vol_ctlr, int err)
{
	if (err) {
		LOG_ERR("VCP volume down error (err %d)", err);
		return;
	}

	LOG_INF("Volume down success");
}

static void vcp_vol_up_cb(struct bt_vcp_vol_ctlr *vol_ctlr, int err)
{
	if (err) {
		LOG_ERR("VCP volume up error (err %d)", err);
		return;
	}

	LOG_INF("Volume up success");
}

static void vcp_mute_cb(struct bt_vcp_vol_ctlr *vol_ctlr, int err)
{
	if (err) {
		LOG_ERR("VCP mute error (err %d)", err);
		return;
	}

	LOG_INF("Mute success");
}

static void vcp_unmute_cb(struct bt_vcp_vol_ctlr *vol_ctlr, int err)
{
	if (err) {
		LOG_ERR("VCP unmute error (err %d)", err);
		return;
	}

	LOG_INF("Unmute success");
}

static void vcp_vol_up_unmute_cb(struct bt_vcp_vol_ctlr *vol_ctlr, int err)
{
	if (err) {
		LOG_ERR("VCP volume up and unmute error (err %d)", err);
		return;
	}

	LOG_INF("Volume up and unmute success");
}

static void vcp_vol_down_unmute_cb(struct bt_vcp_vol_ctlr *vol_ctlr, int err)
{
	if (err) {
		LOG_ERR("VCP volume down and unmute error (err %d)", err);
		return;
	}

	LOG_INF("Volume down and unmute success");
}

static struct bt_vcp_vol_ctlr_cb vcp_callbacks = {
	.discover = vcp_discover_cb,
	.vol_down = vcp_vol_down_cb,
	.vol_up = vcp_vol_up_cb,
	.mute = vcp_mute_cb,
	.unmute = vcp_unmute_cb,
	.vol_up_unmute = vcp_vol_up_unmute_cb,
	.vol_down_unmute = vcp_vol_down_unmute_cb,
};

/* Initialize VCP controller */
int vcp_controller_init(void)
{
	int err;

	err = bt_vcp_vol_ctlr_cb_register(&vcp_callbacks);
	if (err) {
		LOG_ERR("Failed to register VCP callbacks (err %d)", err);
		return err;
	}

	LOG_INF("VCP controller initialized");
	return 0;
}

/* Reset VCP controller state */
void vcp_controller_reset_state(void)
{
	vcp_discovered = false;
	vol_ctlr = NULL;
}

/* VCP demonstration function */
void vcp_controller_demo(void)
{
	int err;
	static uint8_t demo_state = 0;
	static uint8_t abs_volume = 50;

	if (!vol_ctlr || !vcp_discovered) {
		return;
	}

	switch (demo_state) {
	case 0:
		LOG_INF("Requesting volume up...");
		err = bt_vcp_vol_ctlr_vol_up(vol_ctlr);
		if (err) {
			LOG_ERR("Failed to volume up (err %d)", err);
		}
		break;
	case 1:
		LOG_INF("Requesting volume down...");
		err = bt_vcp_vol_ctlr_vol_down(vol_ctlr);
		if (err) {
			LOG_ERR("Failed to volume down (err %d)", err);
		}
		break;
	case 2:
		LOG_INF("Requesting volume up and unmute...");
		err = bt_vcp_vol_ctlr_unmute_vol_up(vol_ctlr);
		if (err) {
			LOG_ERR("Failed to volume up and unmute (err %d)", err);
		}
		break;
	case 3:
		LOG_INF("Requesting volume down and unmute...");
		err = bt_vcp_vol_ctlr_unmute_vol_down(vol_ctlr);
		if (err) {
			LOG_ERR("Failed to volume down and unmute (err %d)", err);
		}
		break;
	case 4:
		abs_volume = (abs_volume == 50) ? 80 : 50;
		LOG_INF("Setting absolute volume to %u...", abs_volume);
		err = bt_vcp_vol_ctlr_set_vol(vol_ctlr, abs_volume);
		if (err) {
			LOG_ERR("Failed to set absolute volume (err %d)", err);
		}
		break;
	case 5:
		LOG_INF("Requesting mute...");
		err = bt_vcp_vol_ctlr_mute(vol_ctlr);
		if (err) {
			LOG_ERR("Failed to mute (err %d)", err);
		}
		break;
	case 6:
		LOG_INF("Requesting unmute...");
		err = bt_vcp_vol_ctlr_unmute(vol_ctlr);
		if (err) {
			LOG_ERR("Failed to unmute (err %d)", err);
		}
		break;
	}

	demo_state = (demo_state + 1) % 7; // Cycle through 7 operations
}
```

## src/vcp_controller.h
```c
#ifndef VCP_CONTROLLER_H
#define VCP_CONTROLLER_H

#include <zephyr/kernel.h>
#include <zephyr/bluetooth/bluetooth.h>
#include <zephyr/bluetooth/conn.h>
#include <zephyr/bluetooth/audio/vcp.h>

/* VCP Controller state */
extern struct bt_conn *default_conn;
extern struct bt_vcp_vol_ctlr *vol_ctlr;
extern bool vcp_discovered;

/* VCP Controller functions */
int vcp_controller_init(void);
void vcp_controller_demo(void);
void vcp_controller_reset_state(void);

/* Note: bt_vcp_vol_ctlr_vol_up_unmute and bt_vcp_vol_ctlr_vol_down_unmute
 * are provided by Zephyr VCP API - no custom declarations needed */

#endif /* VCP_CONTROLLER_H */
```
